## sdkconfig.defaults
```kconfig
# Target target
CONFIG_IDF_TARGET="esp32s3"

# Flash Size (16MB)
CONFIG_ESPTOOLPY_FLASHSIZE_16MB=y
CONFIG_ESPTOOLPY_FLASHSIZE="16MB"
CONFIG_ESPTOOLPY_FLASHMODE_DIO=y
CONFIG_ESPTOOLPY_FLASHFREQ_80M=y

# SPIRAM / PSRAM (8MB Octal)
CONFIG_SPIRAM=y
CONFIG_SPIRAM_BOOT_INIT=y
CONFIG_SPIRAM_TYPE_AUTO=y
CONFIG_SPIRAM_MODE_OCT=y
CONFIG_SPIRAM_SPEED_80M=y
CONFIG_SPIRAM_USE_MALLOC=y
CONFIG_SPIRAM_MEMTEST=y

# Custom Partition Table
CONFIG_PARTITION_TABLE_CUSTOM=y
CONFIG_PARTITION_TABLE_CUSTOM_FILENAME="partitions.csv"
CONFIG_PARTITION_TABLE_FILENAME="partitions.csv"

# FreeRTOS config
CONFIG_FREERTOS_HZ=1000

# mbedTLS security settings for HTTPS
# Increase buffer size to handle certificates from DeepSeek/Telegram
CONFIG_MBEDTLS_ASYMMETRIC_CONTENT_LEN=y
CONFIG_MBEDTLS_SSL_IN_CONTENT_LEN=16384
CONFIG_MBEDTLS_SSL_OUT_CONTENT_LEN=4096

# LWIP (TCP/IP stack) settings for high throughput audio streams
CONFIG_LWIP_TCP_MSS=1460
CONFIG_LWIP_TCP_SND_BUF_DEFAULT=5840
CONFIG_LWIP_TCP_WND_DEFAULT=5840

# HTTP Server config
CONFIG_HTTPD_MAX_REQ_HDR_LEN=2048
CONFIG_HTTPD_MAX_URI_LEN=1024

# FATFS and SPIFFS
CONFIG_SPIFFS_MAX_PARTITIONS=2

# Compiler optimization
CONFIG_COMPILER_OPTIMIZATION_SIZE=y

# Main task stack size
CONFIG_ESP_MAIN_TASK_STACK_SIZE=8192
```
